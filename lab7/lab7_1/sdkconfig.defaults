## lab7/lab7_1/sdkconfig.defaults
```kconfig
CONFIG_MBEDTLS_HAVE_TIME_DATE=y
CONFIG_LWIP_SNTP_MAX_SERVERS=2
CONFIG_PARTITION_TABLE_SINGLE_APP_LARGE=y
CONFIG_EXAMPLE_WIFI_SSID="Dev"
CONFIG_EXAMPLE_WIFI_PASSWORD="123456789"
```
